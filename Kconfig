## Kconfig
```kconfig
# SPDX-License-Identifier: Apache-2.0

mainmenu "TGM Firmware"

source "Kconfig.zephyr"

# Application Kconfig
rsource "src/Kconfig"
rsource "drivers/Kconfig"
```

## app/src/Kconfig
```kconfig
# SPDX-License-Identifier: Apache-2.0

# Application source Kconfig

module = APP
module-str = app
source "subsys/logging/Kconfig.template.log_config"

config PPG_SAMPLES_PER_FRAME
    int "Number of PPG samples per frame"
    default 20
    help
      Number of PPG samples to collect per frame.

config ACC_SAMPLES_PER_FRAME
    int "Number of accelerometer samples per frame"
    default 25
    help
      Number of accelerometer samples to collect per frame.

config BATTERY_MEASUREMENT_INTERVAL
    int "Battery measurement interval in seconds"
    default 300
    help
      Interval between battery measurements in seconds.

config TEMPERATURE_MEASUREMENT_INTERVAL
    int "Temperature measurement interval in seconds"
    default 1
    help
      Interval between temperature measurements in seconds.

config BATTERY_CRITICAL_LOW_SHUTDOWN
    bool "Shutdown system when battery voltage drops below 2.8V"
    default y
    help
      Protects CG-320B cells from over-discharge. When voltage drops
      below 2.8V, the system resets to avoid chemical damage.
```

## boards/byteexplain/pcb00003_gen2/Kconfig
```kconfig
# SPDX-License-Identifier: Apache-2.0
# PCB00003 Gen2 (nRF54L15 / ES4L15BA1)

if BOARD_PCB00003_GEN2

config BT_CTLR
	default y if BT

endif # BOARD_PCB00003_GEN2
```

## boards/byteexplain/pcb00003_gen2/Kconfig.pcb00003_gen2
```kconfig
# SPDX-License-Identifier: Apache-2.0

config BOARD_PCB00003_GEN2
	select SOC_NRF54L15_CPUAPP
```

## boards/byteexplain/pcb00003_gen2/pcb00003_gen2_nrf54l15_cpuapp_defconfig
```kconfig
# SPDX-License-Identifier: Apache-2.0

CONFIG_ARM_MPU=y
CONFIG_HW_STACK_PROTECTION=y
CONFIG_NULL_POINTER_EXCEPTION_DETECTION_NONE=y

CONFIG_CACHE_MANAGEMENT=y
CONFIG_EXTERNAL_CACHE=y
CONFIG_SOC_NRF_FORCE_CONSTLAT=y
CONFIG_NRF_GRTC_START_SYSCOUNTER=y

CONFIG_GPIO=y
CONFIG_SERIAL=n
CONFIG_CONSOLE=y
CONFIG_USE_SEGGER_RTT=y
CONFIG_RTT_CONSOLE=y
CONFIG_UART_CONSOLE=n
CONFIG_PRINTK=y
CONFIG_CLOCK_CONTROL_NRF_K32SRC_XTAL=y
```

## build/Kconfig/Kconfig.shield
```kconfig
osource "/Users/johnacogan67/Projects/tgm_firmware/boards/shields/*/Kconfig.shield"
osource "/Users/johnacogan67/Projects/nrf/boards/shields/*/Kconfig.shield"
```

## build/Kconfig/Kconfig.shield.defconfig
```kconfig
osource "/Users/johnacogan67/Projects/tgm_firmware/boards/shields/*/Kconfig.defconfig"
osource "/Users/johnacogan67/Projects/nrf/boards/shields/*/Kconfig.defconfig"
```

## build/Kconfig/arch/Kconfig
```kconfig
# Load arch Kconfig descriptions.
osource "/Users/johnacogan67/Projects/zephyr/arch/x86/Kconfig"
osource "/Users/johnacogan67/Projects/zephyr/arch/xtensa/Kconfig"
osource "/Users/johnacogan67/Projects/zephyr/arch/sparc/Kconfig"
osource "/Users/johnacogan67/Projects/zephyr/arch/riscv/Kconfig"
osource "/Users/johnacogan67/Projects/zephyr/arch/posix/Kconfig"
osource "/Users/johnacogan67/Projects/zephyr/arch/nios2/Kconfig"
osource "/Users/johnacogan67/Projects/zephyr/arch/mips/Kconfig"
osource "/Users/johnacogan67/Projects/zephyr/arch/arm64/Kconfig"
osource "/Users/johnacogan67/Projects/zephyr/arch/arm/Kconfig"
osource "/Users/johnacogan67/Projects/zephyr/arch/arc/Kconfig"
```

## build/app/Kconfig/soc/Kconfig
```kconfig
# Load Zephyr SoC Kconfig descriptions.
osource "/Users/johnacogan67/tgm_firmware/zephyr/soc/xlnx/zynqmp/Kconfig"
osource "/Users/johnacogan67/tgm_firmware/zephyr/soc/xlnx/zynq7000/Kconfig"
osource "/Users/johnacogan67/tgm_firmware/zephyr/soc/xen/Kconfig"
osource "/Users/johnacogan67/tgm_firmware/zephyr/soc/ti/simplelink/Kconfig"
osource "/Users/johnacogan67/tgm_firmware/zephyr/soc/ti/lm3s6965/Kconfig"
osource "/Users/johnacogan67/tgm_firmware/zephyr/soc/ti/k3/Kconfig"
osource "/Users/johnacogan67/tgm_firmware/zephyr/soc/telink/tlsr/Kconfig"
osource "/Users/johnacogan67/tgm_firmware/zephyr/soc/starfive/jh71xx/Kconfig"
osource "/Users/johnacogan67/tgm_firmware/zephyr/soc/st/stm32/Kconfig"
osource "/Users/johnacogan67/tgm_firmware/zephyr/soc/snps/qemu_arc/Kconfig"
osource "/Users/johnacogan67/tgm_firmware/zephyr/soc/snps/nsim/Kconfig"
osource "/Users/johnacogan67/tgm_firmware/zephyr/soc/snps/hsdk4xd/Kconfig"
osource "/Users/johnacogan67/tgm_firmware/zephyr/soc/snps/hsdk/Kconfig"
osource "/Users/johnacogan67/tgm_firmware/zephyr/soc/snps/emsk/Kconfig"
osource "/Users/johnacogan67/tgm_firmware/zephyr/soc/snps/emsdp/Kconfig"
osource "/Users/johnacogan67/tgm_firmware/zephyr/soc/snps/arc_iot/Kconfig"
osource "/Users/johnacogan67/tgm_firmware/zephyr/soc/silabs/Kconfig"
osource "/Users/johnacogan67/tgm_firmware/zephyr/soc/sifive/sifive_freedom/Kconfig"
osource "/Users/johnacogan67/tgm_firmware/zephyr/soc/rockchip/Kconfig"
osource "/Users/johnacogan67/tgm_firmware/zephyr/soc/renode/riscv_virtual/Kconfig"
osource "/Users/johnacogan67/tgm_firmware/zephyr/soc/renesas/smartbond/Kconfig"
osource "/Users/johnacogan67/tgm_firmware/zephyr/soc/renesas/rzt2m/Kconfig"
osource "/Users/johnacogan67/tgm_firmware/zephyr/soc/renesas/rcar/Kconfig"
osource "/Users/johnacogan67/tgm_firmware/zephyr/soc/renesas/ra/Kconfig"
osource "/Users/johnacogan67/tgm_firmware/zephyr/soc/raspberrypi/Kconfig"
osource "/Users/johnacogan67/tgm_firmware/zephyr/soc/quicklogic/eos_s3/Kconfig"
osource "/Users/johnacogan67/tgm_firmware/zephyr/soc/qemu/virt_riscv/Kconfig"
osource "/Users/johnacogan67/tgm_firmware/zephyr/soc/qemu/malta/Kconfig"
osource "/Users/johnacogan67/tgm_firmware/zephyr/soc/openisa/rv32m1/Kconfig"
osource "/Users/johnacogan67/tgm_firmware/zephyr/soc/nxp/s32/Kconfig"
osource "/Users/johnacogan67/tgm_firmware/zephyr/soc/nxp/rw/Kconfig"
osource "/Users/johnacogan67/tgm_firmware/zephyr/soc/nxp/mcx/Kconfig"
osource "/Users/johnacogan67/tgm_firmware/zephyr/soc/nxp/lpc/Kconfig"
osource "/Users/johnacogan67/tgm_firmware/zephyr/soc/nxp/layerscape/Kconfig"
osource "/Users/johnacogan67/tgm_firmware/zephyr/soc/nxp/kinetis/Kconfig"
osource "/Users/johnacogan67/tgm_firmware/zephyr/soc/nxp/imxrt/Kconfig"
osource "/Users/johnacogan67/tgm_firmware/zephyr/soc/nxp/imx/Kconfig"
osource "/Users/johnacogan67/tgm_firmware/zephyr/soc/nuvoton/numicro/Kconfig"
osource "/Users/johnacogan67/tgm_firmware/zephyr/soc/nuvoton/numaker/Kconfig"
osource "/Users/johnacogan67/tgm_firmware/zephyr/soc/nuvoton/npcx/Kconfig"
osource "/Users/johnacogan67/tgm_firmware/zephyr/soc/nordic/Kconfig"
osource "/Users/johnacogan67/tgm_firmware/zephyr/soc/neorv32/Kconfig"
osource "/Users/johnacogan67/tgm_firmware/zephyr/soc/native/inf_clock/Kconfig"
osource "/Users/johnacogan67/tgm_firmware/zephyr/soc/microchip/miv/Kconfig"
osource "/Users/johnacogan67/tgm_firmware/zephyr/soc/microchip/mec/Kconfig"
osource "/Users/johnacogan67/tgm_firmware/zephyr/soc/lowrisc/opentitan/Kconfig"
osource "/Users/johnacogan67/tgm_firmware/zephyr/soc/litex/litex_vexriscv/Kconfig"
osource "/Users/johnacogan67/tgm_firmware/zephyr/soc/ite/ec/Kconfig"
osource "/Users/johnacogan67/tgm_firmware/zephyr/soc/intel/raptor_lake/Kconfig"
osource "/Users/johnacogan67/tgm_firmware/zephyr/soc/intel/lakemont/Kconfig"
osource "/Users/johnacogan67/tgm_firmware/zephyr/soc/intel/intel_socfpga_std/Kconfig"
osource "/Users/johnacogan67/tgm_firmware/zephyr/soc/intel/intel_socfpga/Kconfig"
osource "/Users/johnacogan67/tgm_firmware/zephyr/soc/intel/intel_niosv/Kconfig"
osource "/Users/johnacogan67/tgm_firmware/zephyr/soc/intel/intel_ish/Kconfig"
osource "/Users/johnacogan67/tgm_firmware/zephyr/soc/intel/intel_adsp/Kconfig"
osource "/Users/johnacogan67/tgm_firmware/zephyr/soc/intel/elkhart_lake/Kconfig"
osource "/Users/johnacogan67/tgm_firmware/zephyr/soc/intel/atom/Kconfig"
osource "/Users/johnacogan67/tgm_firmware/zephyr/soc/intel/apollo_lake/Kconfig"
osource "/Users/johnacogan67/tgm_firmware/zephyr/soc/intel/alder_lake/Kconfig"
osource "/Users/johnacogan67/tgm_firmware/zephyr/soc/infineon/cat3/Kconfig"
osource "/Users/johnacogan67/tgm_firmware/zephyr/soc/infineon/cat1a/Kconfig"
osource "/Users/johnacogan67/tgm_firmware/zephyr/soc/gd/gd32/Kconfig"
osource "/Users/johnacogan67/tgm_firmware/zephyr/soc/gaisler/leon3/Kconfig"
osource "/Users/johnacogan67/tgm_firmware/zephyr/soc/gaisler/gr716a/Kconfig"
osource "/Users/johnacogan67/tgm_firmware/zephyr/soc/espressif/Kconfig"
osource "/Users/johnacogan67/tgm_firmware/zephyr/soc/ene/kb1200/Kconfig"
osource "/Users/johnacogan67/tgm_firmware/zephyr/soc/efinix/sapphire/Kconfig"
osource "/Users/johnacogan67/tgm_firmware/zephyr/soc/cdns/xtensa_sample_controller/Kconfig"
osource "/Users/johnacogan67/tgm_firmware/zephyr/soc/cdns/dc233c/Kconfig"
osource "/Users/johnacogan67/tgm_firmware/zephyr/soc/brcm/bcmvk/Kconfig"
osource "/Users/johnacogan67/tgm_firmware/zephyr/soc/brcm/bcm2712/Kconfig"
osource "/Users/johnacogan67/tgm_firmware/zephyr/soc/brcm/bcm2711/Kconfig"
osource "/Users/johnacogan67/tgm_firmware/zephyr/soc/atmel/sam0/Kconfig"
osource "/Users/johnacogan67/tgm_firmware/zephyr/soc/atmel/sam/Kconfig"
osource "/Users/johnacogan67/tgm_firmware/zephyr/soc/aspeed/Kconfig"
osource "/Users/johnacogan67/tgm_firmware/zephyr/soc/arm/Kconfig"
osource "/Users/johnacogan67/tgm_firmware/zephyr/soc/arm/beetle/Kconfig"
osource "/Users/johnacogan67/tgm_firmware/zephyr/soc/andestech/Kconfig"
osource "/Users/johnacogan67/tgm_firmware/zephyr/soc/ambiq/Kconfig"
osource "/Users/johnacogan67/tgm_firmware/zephyr/soc/altr/zephyr_nios2f/Kconfig"
osource "/Users/johnacogan67/tgm_firmware/zephyr/soc/altr/qemu_nios2/Kconfig"
```

## build/mcuboot/Kconfig/soc/Kconfig
```kconfig
# Load Zephyr SoC Kconfig descriptions.
osource "/Users/johnacogan67/Projects/zephyr/soc/xlnx/zynqmp/Kconfig"
osource "/Users/johnacogan67/Projects/zephyr/soc/xlnx/zynq7000/Kconfig"
osource "/Users/johnacogan67/Projects/zephyr/soc/xen/Kconfig"
osource "/Users/johnacogan67/Projects/zephyr/soc/ti/simplelink/Kconfig"
osource "/Users/johnacogan67/Projects/zephyr/soc/ti/lm3s6965/Kconfig"
osource "/Users/johnacogan67/Projects/zephyr/soc/ti/k3/Kconfig"
osource "/Users/johnacogan67/Projects/zephyr/soc/telink/tlsr/Kconfig"
osource "/Users/johnacogan67/Projects/zephyr/soc/starfive/jh71xx/Kconfig"
osource "/Users/johnacogan67/Projects/zephyr/soc/st/stm32/Kconfig"
osource "/Users/johnacogan67/Projects/zephyr/soc/snps/qemu_arc/Kconfig"
osource "/Users/johnacogan67/Projects/zephyr/soc/snps/nsim/Kconfig"
osource "/Users/johnacogan67/Projects/zephyr/soc/snps/hsdk4xd/Kconfig"
osource "/Users/johnacogan67/Projects/zephyr/soc/snps/hsdk/Kconfig"
osource "/Users/johnacogan67/Projects/zephyr/soc/snps/emsk/Kconfig"
osource "/Users/johnacogan67/Projects/zephyr/soc/snps/emsdp/Kconfig"
osource "/Users/johnacogan67/Projects/zephyr/soc/snps/arc_iot/Kconfig"
osource "/Users/johnacogan67/Projects/zephyr/soc/silabs/Kconfig"
osource "/Users/johnacogan67/Projects/zephyr/soc/sifive/sifive_freedom/Kconfig"
osource "/Users/johnacogan67/Projects/zephyr/soc/rockchip/Kconfig"
osource "/Users/johnacogan67/Projects/zephyr/soc/renode/riscv_virtual/Kconfig"
osource "/Users/johnacogan67/Projects/zephyr/soc/renesas/smartbond/Kconfig"
osource "/Users/johnacogan67/Projects/zephyr/soc/renesas/rzt2m/Kconfig"
osource "/Users/johnacogan67/Projects/zephyr/soc/renesas/rcar/Kconfig"
osource "/Users/johnacogan67/Projects/zephyr/soc/renesas/ra/Kconfig"
osource "/Users/johnacogan67/Projects/zephyr/soc/raspberrypi/Kconfig"
osource "/Users/johnacogan67/Projects/zephyr/soc/quicklogic/eos_s3/Kconfig"
osource "/Users/johnacogan67/Projects/zephyr/soc/qemu/virt_riscv/Kconfig"
osource "/Users/johnacogan67/Projects/zephyr/soc/qemu/malta/Kconfig"
osource "/Users/johnacogan67/Projects/zephyr/soc/openisa/rv32m1/Kconfig"
osource "/Users/johnacogan67/Projects/zephyr/soc/nxp/s32/Kconfig"
osource "/Users/johnacogan67/Projects/zephyr/soc/nxp/rw/Kconfig"
osource "/Users/johnacogan67/Projects/zephyr/soc/nxp/mcx/Kconfig"
osource "/Users/johnacogan67/Projects/zephyr/soc/nxp/lpc/Kconfig"
osource "/Users/johnacogan67/Projects/zephyr/soc/nxp/layerscape/Kconfig"
osource "/Users/johnacogan67/Projects/zephyr/soc/nxp/kinetis/Kconfig"
osource "/Users/johnacogan67/Projects/zephyr/soc/nxp/imxrt/Kconfig"
osource "/Users/johnacogan67/Projects/zephyr/soc/nxp/imx/Kconfig"
osource "/Users/johnacogan67/Projects/zephyr/soc/nuvoton/numicro/Kconfig"
osource "/Users/johnacogan67/Projects/zephyr/soc/nuvoton/numaker/Kconfig"
osource "/Users/johnacogan67/Projects/zephyr/soc/nuvoton/npcx/Kconfig"
osource "/Users/johnacogan67/Projects/zephyr/soc/nordic/Kconfig"
osource "/Users/johnacogan67/Projects/zephyr/soc/neorv32/Kconfig"
osource "/Users/johnacogan67/Projects/zephyr/soc/native/inf_clock/Kconfig"
osource "/Users/johnacogan67/Projects/zephyr/soc/microchip/miv/Kconfig"
osource "/Users/johnacogan67/Projects/zephyr/soc/microchip/mec/Kconfig"
osource "/Users/johnacogan67/Projects/zephyr/soc/lowrisc/opentitan/Kconfig"
osource "/Users/johnacogan67/Projects/zephyr/soc/litex/litex_vexriscv/Kconfig"
osource "/Users/johnacogan67/Projects/zephyr/soc/ite/ec/Kconfig"
osource "/Users/johnacogan67/Projects/zephyr/soc/intel/raptor_lake/Kconfig"
osource "/Users/johnacogan67/Projects/zephyr/soc/intel/lakemont/Kconfig"
osource "/Users/johnacogan67/Projects/zephyr/soc/intel/intel_socfpga_std/Kconfig"
osource "/Users/johnacogan67/Projects/zephyr/soc/intel/intel_socfpga/Kconfig"
osource "/Users/johnacogan67/Projects/zephyr/soc/intel/intel_niosv/Kconfig"
osource "/Users/johnacogan67/Projects/zephyr/soc/intel/intel_ish/Kconfig"
osource "/Users/johnacogan67/Projects/zephyr/soc/intel/intel_adsp/Kconfig"
osource "/Users/johnacogan67/Projects/zephyr/soc/intel/elkhart_lake/Kconfig"
osource "/Users/johnacogan67/Projects/zephyr/soc/intel/atom/Kconfig"
osource "/Users/johnacogan67/Projects/zephyr/soc/intel/apollo_lake/Kconfig"
osource "/Users/johnacogan67/Projects/zephyr/soc/intel/alder_lake/Kconfig"
osource "/Users/johnacogan67/Projects/zephyr/soc/infineon/cat3/Kconfig"
osource "/Users/johnacogan67/Projects/zephyr/soc/infineon/cat1a/Kconfig"
osource "/Users/johnacogan67/Projects/zephyr/soc/gd/gd32/Kconfig"
osource "/Users/johnacogan67/Projects/zephyr/soc/gaisler/leon3/Kconfig"
osource "/Users/johnacogan67/Projects/zephyr/soc/gaisler/gr716a/Kconfig"
osource "/Users/johnacogan67/Projects/zephyr/soc/espressif/Kconfig"
osource "/Users/johnacogan67/Projects/zephyr/soc/ene/kb1200/Kconfig"
osource "/Users/johnacogan67/Projects/zephyr/soc/efinix/sapphire/Kconfig"
osource "/Users/johnacogan67/Projects/zephyr/soc/cdns/xtensa_sample_controller/Kconfig"
osource "/Users/johnacogan67/Projects/zephyr/soc/cdns/dc233c/Kconfig"
osource "/Users/johnacogan67/Projects/zephyr/soc/brcm/bcmvk/Kconfig"
osource "/Users/johnacogan67/Projects/zephyr/soc/brcm/bcm2712/Kconfig"
osource "/Users/johnacogan67/Projects/zephyr/soc/brcm/bcm2711/Kconfig"
osource "/Users/johnacogan67/Projects/zephyr/soc/atmel/sam0/Kconfig"
osource "/Users/johnacogan67/Projects/zephyr/soc/atmel/sam/Kconfig"
osource "/Users/johnacogan67/Projects/zephyr/soc/aspeed/Kconfig"
osource "/Users/johnacogan67/Projects/zephyr/soc/arm/Kconfig"
osource "/Users/johnacogan67/Projects/zephyr/soc/arm/beetle/Kconfig"
osource "/Users/johnacogan67/Projects/zephyr/soc/andestech/Kconfig"
osource "/Users/johnacogan67/Projects/zephyr/soc/ambiq/Kconfig"
osource "/Users/johnacogan67/Projects/zephyr/soc/altr/zephyr_nios2f/Kconfig"
osource "/Users/johnacogan67/Projects/zephyr/soc/altr/qemu_nios2/Kconfig"
```
