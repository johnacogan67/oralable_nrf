## build/mcuboot/Kconfig/soc/Kconfig.sysbuild
```kconfig
# Load SoC sysbuild Kconfig descriptions.
osource "/Users/johnacogan67/Projects/zephyr/soc/xlnx/zynqmp/Kconfig.sysbuild"
osource "/Users/johnacogan67/Projects/zephyr/soc/xlnx/zynq7000/Kconfig.sysbuild"
osource "/Users/johnacogan67/Projects/zephyr/soc/xen/Kconfig.sysbuild"
osource "/Users/johnacogan67/Projects/zephyr/soc/ti/simplelink/Kconfig.sysbuild"
osource "/Users/johnacogan67/Projects/zephyr/soc/ti/lm3s6965/Kconfig.sysbuild"
osource "/Users/johnacogan67/Projects/zephyr/soc/ti/k3/Kconfig.sysbuild"
osource "/Users/johnacogan67/Projects/zephyr/soc/telink/tlsr/Kconfig.sysbuild"
osource "/Users/johnacogan67/Projects/zephyr/soc/starfive/jh71xx/Kconfig.sysbuild"
osource "/Users/johnacogan67/Projects/zephyr/soc/st/stm32/Kconfig.sysbuild"
osource "/Users/johnacogan67/Projects/zephyr/soc/snps/qemu_arc/Kconfig.sysbuild"
osource "/Users/johnacogan67/Projects/zephyr/soc/snps/nsim/Kconfig.sysbuild"
osource "/Users/johnacogan67/Projects/zephyr/soc/snps/hsdk4xd/Kconfig.sysbuild"
osource "/Users/johnacogan67/Projects/zephyr/soc/snps/hsdk/Kconfig.sysbuild"
osource "/Users/johnacogan67/Projects/zephyr/soc/snps/emsk/Kconfig.sysbuild"
osource "/Users/johnacogan67/Projects/zephyr/soc/snps/emsdp/Kconfig.sysbuild"
osource "/Users/johnacogan67/Projects/zephyr/soc/snps/arc_iot/Kconfig.sysbuild"
osource "/Users/johnacogan67/Projects/zephyr/soc/silabs/Kconfig.sysbuild"
osource "/Users/johnacogan67/Projects/zephyr/soc/sifive/sifive_freedom/Kconfig.sysbuild"
osource "/Users/johnacogan67/Projects/zephyr/soc/rockchip/Kconfig.sysbuild"
osource "/Users/johnacogan67/Projects/zephyr/soc/renode/riscv_virtual/Kconfig.sysbuild"
osource "/Users/johnacogan67/Projects/zephyr/soc/renesas/smartbond/Kconfig.sysbuild"
osource "/Users/johnacogan67/Projects/zephyr/soc/renesas/rzt2m/Kconfig.sysbuild"
osource "/Users/johnacogan67/Projects/zephyr/soc/renesas/rcar/Kconfig.sysbuild"
osource "/Users/johnacogan67/Projects/zephyr/soc/renesas/ra/Kconfig.sysbuild"
osource "/Users/johnacogan67/Projects/zephyr/soc/raspberrypi/Kconfig.sysbuild"
osource "/Users/johnacogan67/Projects/zephyr/soc/quicklogic/eos_s3/Kconfig.sysbuild"
osource "/Users/johnacogan67/Projects/zephyr/soc/qemu/virt_riscv/Kconfig.sysbuild"
osource "/Users/johnacogan67/Projects/zephyr/soc/qemu/malta/Kconfig.sysbuild"
osource "/Users/johnacogan67/Projects/zephyr/soc/openisa/rv32m1/Kconfig.sysbuild"
osource "/Users/johnacogan67/Projects/zephyr/soc/nxp/s32/Kconfig.sysbuild"
osource "/Users/johnacogan67/Projects/zephyr/soc/nxp/rw/Kconfig.sysbuild"
osource "/Users/johnacogan67/Projects/zephyr/soc/nxp/mcx/Kconfig.sysbuild"
osource "/Users/johnacogan67/Projects/zephyr/soc/nxp/lpc/Kconfig.sysbuild"
osource "/Users/johnacogan67/Projects/zephyr/soc/nxp/layerscape/Kconfig.sysbuild"
osource "/Users/johnacogan67/Projects/zephyr/soc/nxp/kinetis/Kconfig.sysbuild"
osource "/Users/johnacogan67/Projects/zephyr/soc/nxp/imxrt/Kconfig.sysbuild"
osource "/Users/johnacogan67/Projects/zephyr/soc/nxp/imx/Kconfig.sysbuild"
osource "/Users/johnacogan67/Projects/zephyr/soc/nuvoton/numicro/Kconfig.sysbuild"
osource "/Users/johnacogan67/Projects/zephyr/soc/nuvoton/numaker/Kconfig.sysbuild"
osource "/Users/johnacogan67/Projects/zephyr/soc/nuvoton/npcx/Kconfig.sysbuild"
osource "/Users/johnacogan67/Projects/zephyr/soc/nordic/Kconfig.sysbuild"
osource "/Users/johnacogan67/Projects/zephyr/soc/neorv32/Kconfig.sysbuild"
osource "/Users/johnacogan67/Projects/zephyr/soc/native/inf_clock/Kconfig.sysbuild"
osource "/Users/johnacogan67/Projects/zephyr/soc/microchip/miv/Kconfig.sysbuild"
osource "/Users/johnacogan67/Projects/zephyr/soc/microchip/mec/Kconfig.sysbuild"
osource "/Users/johnacogan67/Projects/zephyr/soc/lowrisc/opentitan/Kconfig.sysbuild"
osource "/Users/johnacogan67/Projects/zephyr/soc/litex/litex_vexriscv/Kconfig.sysbuild"
osource "/Users/johnacogan67/Projects/zephyr/soc/ite/ec/Kconfig.sysbuild"
osource "/Users/johnacogan67/Projects/zephyr/soc/intel/raptor_lake/Kconfig.sysbuild"
osource "/Users/johnacogan67/Projects/zephyr/soc/intel/lakemont/Kconfig.sysbuild"
osource "/Users/johnacogan67/Projects/zephyr/soc/intel/intel_socfpga_std/Kconfig.sysbuild"
osource "/Users/johnacogan67/Projects/zephyr/soc/intel/intel_socfpga/Kconfig.sysbuild"
osource "/Users/johnacogan67/Projects/zephyr/soc/intel/intel_niosv/Kconfig.sysbuild"
osource "/Users/johnacogan67/Projects/zephyr/soc/intel/intel_ish/Kconfig.sysbuild"
osource "/Users/johnacogan67/Projects/zephyr/soc/intel/intel_adsp/Kconfig.sysbuild"
osource "/Users/johnacogan67/Projects/zephyr/soc/intel/elkhart_lake/Kconfig.sysbuild"
osource "/Users/johnacogan67/Projects/zephyr/soc/intel/atom/Kconfig.sysbuild"
osource "/Users/johnacogan67/Projects/zephyr/soc/intel/apollo_lake/Kconfig.sysbuild"
osource "/Users/johnacogan67/Projects/zephyr/soc/intel/alder_lake/Kconfig.sysbuild"
osource "/Users/johnacogan67/Projects/zephyr/soc/infineon/cat3/Kconfig.sysbuild"
osource "/Users/johnacogan67/Projects/zephyr/soc/infineon/cat1a/Kconfig.sysbuild"
osource "/Users/johnacogan67/Projects/zephyr/soc/gd/gd32/Kconfig.sysbuild"
osource "/Users/johnacogan67/Projects/zephyr/soc/gaisler/leon3/Kconfig.sysbuild"
osource "/Users/johnacogan67/Projects/zephyr/soc/gaisler/gr716a/Kconfig.sysbuild"
osource "/Users/johnacogan67/Projects/zephyr/soc/espressif/Kconfig.sysbuild"
osource "/Users/johnacogan67/Projects/zephyr/soc/ene/kb1200/Kconfig.sysbuild"
osource "/Users/johnacogan67/Projects/zephyr/soc/efinix/sapphire/Kconfig.sysbuild"
osource "/Users/johnacogan67/Projects/zephyr/soc/cdns/xtensa_sample_controller/Kconfig.sysbuild"
osource "/Users/johnacogan67/Projects/zephyr/soc/cdns/dc233c/Kconfig.sysbuild"
osource "/Users/johnacogan67/Projects/zephyr/soc/brcm/bcmvk/Kconfig.sysbuild"
osource "/Users/johnacogan67/Projects/zephyr/soc/brcm/bcm2712/Kconfig.sysbuild"
osource "/Users/johnacogan67/Projects/zephyr/soc/brcm/bcm2711/Kconfig.sysbuild"
osource "/Users/johnacogan67/Projects/zephyr/soc/atmel/sam0/Kconfig.sysbuild"
osource "/Users/johnacogan67/Projects/zephyr/soc/atmel/sam/Kconfig.sysbuild"
osource "/Users/johnacogan67/Projects/zephyr/soc/aspeed/Kconfig.sysbuild"
osource "/Users/johnacogan67/Projects/zephyr/soc/arm/Kconfig.sysbuild"
osource "/Users/johnacogan67/Projects/zephyr/soc/arm/beetle/Kconfig.sysbuild"
osource "/Users/johnacogan67/Projects/zephyr/soc/andestech/Kconfig.sysbuild"
osource "/Users/johnacogan67/Projects/zephyr/soc/ambiq/Kconfig.sysbuild"
osource "/Users/johnacogan67/Projects/zephyr/soc/altr/zephyr_nios2f/Kconfig.sysbuild"
osource "/Users/johnacogan67/Projects/zephyr/soc/altr/qemu_nios2/Kconfig.sysbuild"
```

## build_pcb00003/Kconfig/Kconfig.shield.defconfig
```kconfig
osource "/Users/johnacogan67/tgm_firmware/tgm_firmware/boards/shields/*/Kconfig.defconfig"
osource "/Users/johnacogan67/tgm_firmware/nrf/boards/shields/*/Kconfig.defconfig"
```

## build_pcb00003/Kconfig/arch/Kconfig
```kconfig
# Load arch Kconfig descriptions.
osource "/Users/johnacogan67/tgm_firmware/zephyr/arch/x86/Kconfig"
osource "/Users/johnacogan67/tgm_firmware/zephyr/arch/xtensa/Kconfig"
osource "/Users/johnacogan67/tgm_firmware/zephyr/arch/sparc/Kconfig"
osource "/Users/johnacogan67/tgm_firmware/zephyr/arch/riscv/Kconfig"
osource "/Users/johnacogan67/tgm_firmware/zephyr/arch/posix/Kconfig"
osource "/Users/johnacogan67/tgm_firmware/zephyr/arch/nios2/Kconfig"
osource "/Users/johnacogan67/tgm_firmware/zephyr/arch/mips/Kconfig"
osource "/Users/johnacogan67/tgm_firmware/zephyr/arch/arm64/Kconfig"
osource "/Users/johnacogan67/tgm_firmware/zephyr/arch/arm/Kconfig"
osource "/Users/johnacogan67/tgm_firmware/zephyr/arch/arc/Kconfig"
```

## dts/bindings/sensor/adi,maxm86161.yaml
```yaml
# Copyright (c) 2024 WeeGee bv

description: MAXM86161 Integrated Optical Module for Heart Rate and SpO2 Measurement

compatible: "adi,maxm86161"

include: [sensor-device.yaml, i2c-device.yaml]

properties:
  int-gpios:
    type: phandle-array
    required: false
    description: Interrupt pin.
```
