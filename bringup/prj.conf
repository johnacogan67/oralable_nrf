## CMakeLists.txt
```
cmake_minimum_required(VERSION 3.20.0)

set(BOARD_ROOT ${CMAKE_CURRENT_SOURCE_DIR}/..)

find_package(Zephyr REQUIRED HINTS $ENV{ZEPHYR_BASE})
project(oralable_gen2_rtt)

target_sources(app PRIVATE src/main.c)
```

## prj.conf
```kconfig
CONFIG_PRINTK=y
CONFIG_USE_SEGGER_RTT=y
CONFIG_RTT_CONSOLE=y
CONFIG_UART_CONSOLE=n
CONFIG_SERIAL=n
```

## src/main.c
```c
/*
 * Copyright (c) 2026 ByteExplain / JAC Dental
 * SPDX-License-Identifier: Apache-2.0
 *
 * Gen 2 first image. Prints on RTT. Does not touch power or sensor pins.
 */

#include <zephyr/kernel.h>
#include <zephyr/sys/printk.h>

int main(void)
{
	printk("Oralable Gen2 RTT hello\n");

	while (1) {
		printk("Oralable Gen2 alive\n");
		k_sleep(K_SECONDS(2));
	}

	return 0;
}
```
