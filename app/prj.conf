## CMakeLists.txt
```
# -----------------------------------------------------------------------------
# Copyright (c) 2024 WeeGee bv

cmake_minimum_required(VERSION 3.13.1)

# Avoid picking the workspace root as an implicit Zephyr module
# (it contains a nested Zephyr checkout at ./zephyr/), which causes
# recursive Kconfig loading when building this app target.
set(ZEPHYR_MODULES
    "${CMAKE_CURRENT_SOURCE_DIR}/../nrf"
    "${CMAKE_CURRENT_SOURCE_DIR}/../nrfxlib"
    "${CMAKE_CURRENT_SOURCE_DIR}/../bootloader/mcuboot"
    "${CMAKE_CURRENT_SOURCE_DIR}/../modules/hal/nordic"
    "${CMAKE_CURRENT_SOURCE_DIR}/../modules/hal/cmsis"
    "${CMAKE_CURRENT_SOURCE_DIR}/../modules/debug/segger"
    "${CMAKE_CURRENT_SOURCE_DIR}/../modules/crypto/tinycrypt"
    "${CMAKE_CURRENT_SOURCE_DIR}/../modules/crypto/mbedtls"
    "${CMAKE_CURRENT_SOURCE_DIR}/../modules/lib/zcbor"
    "${CMAKE_CURRENT_SOURCE_DIR}/../module"
  CACHE STRING "Pinned Zephyr modules for app target" FORCE
)

# Repo-root dts/bindings (adi,maxm86161 / st,lis2dtw12 int-gpios) must be on
# DTS_ROOT or GPIO_DT_SPEC_GET(..., int_gpios) has no generated macros.
list(APPEND DTS_ROOT "${CMAKE_CURRENT_SOURCE_DIR}/..")

find_package(Zephyr REQUIRED HINTS $ENV{ZEPHYR_BASE})

project(app LANGUAGES C)

target_include_directories(app PRIVATE ../include)

target_sources(app PRIVATE src/main.c)
target_sources(app PRIVATE src/ble.c)
target_sources(app PRIVATE src/tgm_service.c)
target_sources(app PRIVATE src/ppg.c)
target_sources(app PRIVATE src/acc.c)
target_sources(app PRIVATE src/battery.c)
target_sources(app PRIVATE src/battery_led_indicator.c)
target_sources(app PRIVATE src/charge_detector.c)
target_sources(app PRIVATE src/sensor_i2c.c)
target_sources(app PRIVATE src/early_rtt.c)
```

## Kconfig
```
# Copyright (c) 2021 Nordic Semiconductor ASA
# SPDX-License-Identifier: Apache-2.0
#
# This file is the application Kconfig entry point. All application Kconfig
# options can be defined here or included via other application Kconfig files.
# You can browse these options using the west targets menuconfig (terminal) or
# guiconfig (GUI).

# nRF sysbuild always writes CHIP and MCUBOOT_HARDWARE_DOWNGRADE_PREVENTION into
# the app .config.sysbuild fragment. Matter defines CHIP; downgrade prevention is
# only in the NCS Kconfig tree on nRF53/nRF91 — stubs keep nRF52 sysbuild clean.
config CHIP
	bool "Matter (unused on Oralable)"
	default n

config MCUBOOT_HARDWARE_DOWNGRADE_PREVENTION
	bool "MCUboot HW downgrade prevention (nRF52 stub)"
	default n

source "Kconfig.zephyr"

config PPG_SAMPLES_PER_FRAME
    int "Number of PPG samples per frame"
    default 25
    help
      Number of PPG samples per frame. 

config ACC_SAMPLES_PER_FRAME
    int "Number of ACC samples per frame"
    default 25
    help
      Number of accelerometer samples per frame. 

  config BATTERY_MEASUREMENT_INTERVAL
    int "Battery measurement interval"
    default 300
    help
      Battery sampling interval in seconds.

  config TEMPERATURE_MEASUREMENT_INTERVAL
    int "Temperature measurement interval"
    default 1
    help
      Temperature sampling interval in seconds.

config TGM_CONNECT_PROBE_DURATION_S
    int "BLE connect diagnostic probe duration (seconds)"
    default 10
    help
      After a central connects, stream PPG/ACC/temp for this many seconds even when
      off-body (worn=0), using a dim LED profile so bench/charger diagnostics get
      real sensor data without locking worn from die heating. Set 0 to disable.

config TGM_DEBUG_REBOOT_INTERVAL_S
    int "Optional debug periodic reboot interval (seconds, 0=off)"
    default 0
    help
      When non-zero, firmware warm-reboots after this many seconds since boot.
      Intended for bench recovery on Gen1 units with stuck BLE advertising.
      Can also be set at runtime via GATT config opcode 0x0A from the iOS app.

config TGM_POST_PROBE_WORN_LOCKOUT_S
    int "Post-probe worn temperature lockout (seconds)"
    default 90
    help
      After the connect probe ends, die temperature cannot latch worn=1 for this many
      seconds. Prevents bench PPG heat from falsely setting worn off-body. Set 0 to
      disable (only the active probe window blocks worn latch).

config CHRSTS_STAT_ACTIVITY
    bool "Interpret LTC4124 STAT blink as charging (REV10)"
    default y
    help
      LTC4124 STAT (CHRSTS) blinks while charging and stays asserted when charge
      current tapers. When enabled, firmware treats edge activity as charging,
      steady assert as on-pad taper, and steady inactive as undocked. This replaces
      the old "stable GPIO level" dock debounce that never latched during blink.

config CHRSTS_BLINK_EDGE_MIN
    int "Min CHRSTS edges per dock poll to declare charging"
    default 2
    depends on CHRSTS_STAT_ACTIVITY
    help
      GPIO both-edge interrupts counted over each dock-poll window. At or above
      this count, on_dock=1 and charge_active=1 (flashing red LED).

config CHRSTS_TAPER_HOLD_S
    int "Steady STAT assert seconds before charge taper"
    default 3
    depends on CHRSTS_STAT_ACTIVITY
    help
      After blinking stops, STAT must stay asserted this many dock-poll seconds
      before charge_active clears (solid red / almost-full, not necessarily 4.2 V).

config CHRSTS_UNDOCK_HOLD_S
    int "Steady STAT inactive seconds before undock"
    default 3
    depends on CHRSTS_STAT_ACTIVITY
    help
      STAT must stay inactive with no edges this many dock-poll seconds before
      on_dock clears.

config CHRSTS_DEBOUNCE_MS
    int "Charger detect (chrsts) debounce (milliseconds)"
    default 2000
    depends on !CHRSTS_STAT_ACTIVITY
    help
      Legacy: minimum stable time before a chrsts GPIO edge updates charging state.
      Unused when CHRSTS_STAT_ACTIVITY is enabled.

config CHRSTS_SAMPLE_COUNT
    int "Charger detect (chrsts) majority-vote sample count"
    default 3
    help
      After debounce, read chrsts this many times; charging state changes only when a
      strict majority of samples agree on the new level. Also used for bench snapshots.

config CHRSTS_SAMPLE_INTERVAL_MS
    int "Charger detect (chrsts) sample spacing (milliseconds)"
    default 50
    help
      Delay between chrsts GPIO reads during majority-vote sampling.

config CHRSTS_INVERT
    bool "Invert chrsts GPIO active level"
    default n
    help
      Invert the logical chrsts level after devicetree GPIO_ACTIVE_LOW is applied.
      Leave disabled unless bench testing shows the dock pin is wired active-high.

config DOCK_STATE_STABLE_S
    int "Dock GPIO stable time before LED/state change (seconds)"
    default 8
    depends on !CHRSTS_STAT_ACTIVITY
    help
      Legacy: chrsts GPIO must remain unchanged this many dock-poll periods before
      on_dock flips. Unused when CHRSTS_STAT_ACTIVITY is enabled.

config DOCK_GPIO_MISMATCH_VOTES
    int "Consecutive chrsts mismatches before debounce resets"
    default 3
    depends on !CHRSTS_STAT_ACTIVITY
    help
      Legacy: consecutive dock-poll samples that disagree with the stable level.
      Unused when CHRSTS_STAT_ACTIVITY is enabled.

config WORN_OFF_DOCK_SUSTAIN_S
    int "Off-dock worn latch sustain (seconds)"
    default 120
    help
      When not on the charger, die temperature must remain above the worn latch
      threshold for this many consecutive seconds before worn=1 is set. Prevents
      bench BLE/probe die heat from falsely latching worn off-body. Set 0 to latch
      immediately when temperature exceeds the threshold (legacy behavior).

module = APP
module-str = APP
source "subsys/logging/Kconfig.template.log_config"
```

## sample.yaml
```
# This file is provided so that the application can be compiled using Twister,
# the Zephyr testing tool. In this file, multiple combinations can be specified,
# so that you can easily test all of them locally or in CI.
sample:
  description: Firmware for the Teeth Grinder Monitor (TGM) application
  name: tgm_firmware
common:
  sysbuild: true
  build_only: true
  integration_platforms:
    - a200451
    - pcb00003
tests:
  app.default: {}
  app.debug:
    extra_overlay_confs:
      - debug.conf
```

## sysbuild.conf
```
# MCUboot + signed OTA images (app_update.bin) for mcumgr BLE DFU.
SB_CONFIG_BOOTLOADER_MCUBOOT=y

# nRF52832 is not covered by the NCS default ECDSA default (nRF52840-only).
SB_CONFIG_BOOT_SIGNATURE_TYPE_ECDSA_P256=y
```

## prj.conf
```kconfig
# Copyright (c) 2024 WeeGee bv
#
# This file contains selected Kconfig options for the TGM application.

# Enable BLE
CONFIG_BT=y
CONFIG_BT_PERIPHERAL=y
CONFIG_BT_DEVICE_NAME="Oralable"

# Peripheral connection preferences (interval in 1.25ms units; supervision timeout in 10ms units).
# NCS defaults use a very short supervision timeout (~420ms), which drops nRF Connect / iOS
# links right after enabling notifications. Use 32s (NCS max for nRF52) so brief notify stalls do not drop the link.
CONFIG_BT_GAP_AUTO_UPDATE_CONN_PARAMS=y
CONFIG_BT_GAP_PERIPHERAL_PREF_PARAMS=y
CONFIG_BT_PERIPHERAL_PREF_MIN_INT=12
CONFIG_BT_PERIPHERAL_PREF_MAX_INT=36
CONFIG_BT_PERIPHERAL_PREF_LATENCY=0
CONFIG_BT_PERIPHERAL_PREF_TIMEOUT=3200

# +4 dBm advertising/connection TX (nRF52832 max) — improves scan RSSI at ~30 cm cheek/temple range.
CONFIG_BT_CTLR_TX_PWR_PLUS_4=y

# Extra ACL/L2CAP TX buffers reduce bt_gatt_notify -ENOMEM under ACC+PPG+temp load.
CONFIG_BT_L2CAP_TX_BUF_COUNT=12
CONFIG_BT_ATT_TX_COUNT=12

# For requesting ATT_MTU update
CONFIG_BT_GATT_CLIENT=y
CONFIG_BT_DATA_LEN_UPDATE=y
# For data length update
CONFIG_BT_USER_DATA_LEN_UPDATE=y
# Max supported by Nordic Softdevice controller
CONFIG_BT_CTLR_DATA_LENGTH_MAX=251
CONFIG_BT_BUF_ACL_TX_SIZE=251
CONFIG_BT_BUF_ACL_RX_SIZE=251
# Maximum supported by Nordic Softdevice controller (Data length - 4)
CONFIG_BT_L2CAP_TX_MTU=247

# Enable Floating Point Unit
CONFIG_FPU=y

# Enable the sensor drivers
CONFIG_GPIO=y
CONFIG_I2C=y
CONFIG_SENSOR=y
CONFIG_ADC=y

# PPG
CONFIG_MAXM86161=y
CONFIG_PPG_SAMPLES_PER_FRAME=20

# Accelerometer
CONFIG_LIS2DTW12=y
CONFIG_ACC_SAMPLES_PER_FRAME=25

# Battery
CONFIG_BATTERY_MEASUREMENT_INTERVAL=300

# LTC4124 STAT blinks while charging — treat edges as charge_active (FW >= 1.0.70).
CONFIG_CHRSTS_STAT_ACTIVITY=y

# Temperature
CONFIG_SENSOR=y
CONFIG_TEMPERATURE_MEASUREMENT_INTERVAL=1

# Phase 0 vitals: no dim-green connect probe (avoids solid-green confusion on bench).
CONFIG_TGM_CONNECT_PROBE_DURATION_S=0

# Debug periodic reboot — 0 = off (production). Set from iOS via 00B opcode 0x0A for bench.
CONFIG_TGM_DEBUG_REBOOT_INTERVAL_S=0

# PPG + ACC work handlers use large frames; avoid system workqueue overflow.
CONFIG_SYSTEM_WORKQUEUE_STACK_SIZE=3072

# Debugging
CONFIG_LOG=y
CONFIG_LOG_PROCESS_THREAD_STACK_SIZE=1024
CONFIG_DEBUG_OPTIMIZATIONS=y
CONFIG_DEBUG_THREAD_INFO=y

# Sysbuild + board defconfig can emit deprecated-Kconfig warnings as errors.
CONFIG_WARN_DEPRECATED=n

# Required before sysbuild merges .config.sysbuild (nRF MCUboot Kconfig symbols).
CONFIG_BOOTLOADER_MCUBOOT=y

# DFU / OTA (MCUboot + mcumgr SMP over BLE)
# NCS sample helper wires the recommended OTA defaults (Academy Intermediate L9).
# For a fully custom production cut, replace with the explicit list below and
# enable CONFIG_MCUMGR_TRANSPORT_BT_PERM_RW_AUTHEN once pairing UX exists.
CONFIG_NCS_SAMPLE_MCUMGR_BT_OTA_DFU=y
CONFIG_NCS_SAMPLE_MCUMGR_BT_OTA_DFU_SPEEDUP=y
CONFIG_MCUMGR=y
CONFIG_NET_BUF=y
CONFIG_ZCBOR=y
CONFIG_CRC=y
CONFIG_IMG_MANAGER=y
CONFIG_STREAM_FLASH=y
CONFIG_FLASH_MAP=y
CONFIG_FLASH=y
CONFIG_MCUMGR_GRP_IMG=y
CONFIG_MCUMGR_GRP_OS=y
CONFIG_MCUMGR_GRP_OS_BOOTLOADER_INFO=y
CONFIG_MCUMGR_TRANSPORT_BT=y
CONFIG_MCUMGR_TRANSPORT_BT_REASSEMBLY=y
CONFIG_MCUMGR_TRANSPORT_BT_CONN_PARAM_CONTROL=y
# Static SMP GATT registration (avoids SYS_INIT-before-bt_enable miss).
CONFIG_MCUMGR_TRANSPORT_BT_DYNAMIC_SVC_REGISTRATION=n
# Production hardening (requires bonding/pairing with Device Manager):
# CONFIG_MCUMGR_TRANSPORT_BT_PERM_RW_AUTHEN=y
```

## boards/pcb00003_gen2_nrf54l15_cpuapp.conf
```kconfig
# OTA uses the same MCUboot and mcumgr switches as prj.conf.
# The image now on the MAM has no bootloader, so the first copy of this
# build goes on over SWD as merged.hex. After that, Device Manager uses
# dfu_application.zip.
CONFIG_REBOOT=y
# Boot log was filling the 1 KB up-buffer before Advertising started.
CONFIG_SEGGER_RTT_BUFFER_SIZE_UP=4096

# Crystal load is not a measured value. The advertiser was proven on the RC.
CONFIG_CLOCK_CONTROL_NRF_K32SRC_RC=y
CONFIG_CLOCK_CONTROL_NRF_K32SRC_XTAL=n
CONFIG_CLOCK_CONTROL_NRF_K32SRC_RC_CALIBRATION=y
CONFIG_CLOCK_CONTROL_NRF_K32SRC_500PPM=y

# The advertiser halted in arch_system_halt during controller startup
# when the log thread stack was 768.
CONFIG_MAIN_STACK_SIZE=4096
CONFIG_BT_RX_STACK_SIZE=4096
CONFIG_LOG_PROCESS_THREAD_STACK_SIZE=2048

# LP270829 is not the CG-320B. 3487 mV is about 20% on this span, not empty.
CONFIG_ORALABLE_GAUGE_VMIN_MV=3300
CONFIG_ORALABLE_GAUGE_VMAX_MV=4200
```

## src/acc.c
```c
/*
 * Copyright (c) 2024 WeeGee bv
 */

#include <zephyr/devicetree.h>
#include <zephyr/drivers/gpio.h>
#include <zephyr/drivers/i2c.h>

#include "tgm_service.h"
#include "acc.h"
#include "sensor_i2c.h"

#include <zephyr/logging/log.h>
LOG_MODULE_REGISTER(acc, CONFIG_APP_LOG_LEVEL);

static struct gpio_callback acc_int_cb;
static struct k_work read_acc_data_work;
static bool acc_running;

#ifdef CONFIG_LIS2DTW12
#include <app/drivers/lis2dtw12.h>

#define LIS2DTW12_NODE DT_NODELABEL(lis2dtw12)
#define ACC_INT_PIN 6
static const struct device *acc_int_port = DEVICE_DT_GET(DT_NODELABEL(gpio0));

static struct i2c_dt_spec i2c = I2C_DT_SPEC_GET(LIS2DTW12_NODE);
#else
// Give a build error
#error "No valid accelerometer sensor driver enabled"
#endif

/**
 * @brief Callback function for the accelerometer sensor interrupt
 *
 * @param dev Pointer to the gpio port that triggered the callback
 * @param cb Pointer to the callback data that was used to set up the callback
 * @param pins Bitmask of pins that triggered the callback
 * @return int
 */
static void acc_int_handler(const struct device *dev, struct gpio_callback *cb, uint32_t pins)
{
    ARG_UNUSED(dev);
    ARG_UNUSED(cb);
    if (pins & BIT(ACC_INT_PIN))
    {
        // Read the accelerometer data outside of the ISR
        k_work_submit(&read_acc_data_work);
    }

    return;
}

static void acc_read_data(struct k_work *work)
{
    struct acc_sample acc_data[CONFIG_ACC_SAMPLES_PER_FRAME];
    uint8_t sample_count;

    sensor_i2c_lock();
    int err = acc_sensor_get_data(&i2c, acc_data, &sample_count);
    sensor_i2c_unlock();
    if (err)
    {
        LOG_ERR("Failed to read accelerometer data");
        return;
    }

    if (sample_count == 0)
    {
        return;
    }

    err = tgm_service_send_acc_notify(acc_data, sample_count);
    if (err && err != -EACCES)
    {
        LOG_WRN("ACC notify failed (%d)", err);
        return;
    }

    return;
}

int acc_init(void)
{
    int err;

    // Initialize the I2C bus
    if (!i2c_is_ready_dt(&i2c))
    {
        LOG_ERR("I2C device not ready during initialization of accelerometer sensor");
        return -ENODEV;
    }

    // Initialize the GPIO port
    if (!device_is_ready(acc_int_port))
    {
        LOG_ERR("GPIO device not ready during initialization of accelerometer sensor");
        return -ENODEV;
    }

    // Intialize the int pin as input
    err = gpio_pin_configure(acc_int_port, ACC_INT_PIN, GPIO_INPUT);
    if (err)
    {
        LOG_ERR("Failed to configure accelerometer sensor int pin as input");
        return err;
    }

    // Initialize the interrupt callback
    gpio_init_callback(&acc_int_cb, acc_int_handler, BIT(ACC_INT_PIN));
    err = gpio_add_callback(acc_int_port, &acc_int_cb);
    if (err)
    {
        LOG_ERR("Failed to add callback to accelerometer sensor int pin");
        return err;
    }

    // Initialize the work item
    k_work_init(&read_acc_data_work, acc_read_data);

    return 0;
}

int acc_start(void)
{
    if (acc_running)
    {
        return 0;
    }

    sensor_i2c_lock();
    int err = acc_sensor_start(&i2c);
    sensor_i2c_unlock();
    if (err)
    {
        LOG_ERR("Failed to start accelerometer sensor");
        return err;
    }

    err = gpio_pin_interrupt_configure(acc_int_port, ACC_INT_PIN, GPIO_INT_EDGE_TO_ACTIVE);
    if (err)
    {
        LOG_ERR("Failed to configure accelerometer sensor int pin interrupt");
        sensor_i2c_lock();
        (void)acc_sensor_stop(&i2c);
        sensor_i2c_unlock();
        return err;
    }

    acc_running = true;
    return 0;
}

int acc_stop(void)
{
    if (!acc_running)
    {
        return 0;
    }

    int err = gpio_pin_interrupt_configure(acc_int_port, ACC_INT_PIN, GPIO_INT_DISABLE);
    if (err)
    {
        LOG_ERR("Failed to disable accelerometer sensor int pin interrupt");
        return err;
    }

    sensor_i2c_lock();
    err = acc_sensor_stop(&i2c);
    sensor_i2c_unlock();
    /* Clear even if I2C stop failed so acc_start() will re-init. */
    acc_running = false;
    if (err)
    {
        LOG_ERR("Failed to stop accelerometer sensor");
        return err;
    }

    return 0;
}
```

## src/acc.h
```c
/*
 * Copyright (c) 2024 WeeGee bv
 */

#ifndef ACC_H_
#define ACC_H_

#include <zephyr/kernel.h>

/**
 * @brief Initialize the accelerometer sensor
 *
 * @return int 0 on success, negative error code on failure
 */
int acc_init(void);

/**
 * @brief Start the accelerometer sensor with default configuration
 *
 * @return int 0 on success, negative error code on failure
 */
int acc_start(void);

/**
 * @brief Stop the accelerometer sensor
 *
 * @return int 0 on success, negative error code on failure
 */
int acc_stop(void);

/**
 * @brief Read a register from the accelerometer sensor and report over BLE
 *
 * @param[in] reg Register address
 * @return int 0 on success, negative error code on failure
 */
int acc_read_reg(uint8_t reg);

/**
 * @brief Write a register to the accelerometer sensor and report over BLE
 *
 * @param[in] reg Register address
 * @param[in] data Data to write
 * @return int 0 on success, negative error code on failure
 */
int acc_write_reg(uint8_t reg, uint8_t data);

#endif /* ACC_H_ */
```

## src/battery.c
```c
/*
 * Copyright (c) 2024 WeeGee bv
 * PROJECT: POWER_PROFILER_INTEGRATION (2026-02-27)
 *
 * nRF52832 SAADC battery measurement for CG-320B (15 mAh).
 * ADC: 12-bit, 0.6V internal ref, devicetree gain (PCB uses ADC_GAIN_1).
 * For REV10 with 1/6 gain: add overlay with zephyr,gain = "ADC_GAIN_1_6".
 * Voltage divider scale 11: 4.35V peak -> ~0.395V at ADC input.
 */

#include <zephyr/kernel.h>
#include <zephyr/device.h>
#include <zephyr/devicetree.h>
#include <zephyr/drivers/adc.h>
#include <zephyr/drivers/gpio.h>
#include <zephyr/sys/reboot.h>

#include "battery.h"
#include "tgm_service.h"

#include <zephyr/logging/log.h>
LOG_MODULE_REGISTER(battery, CONFIG_APP_LOG_LEVEL);

#define VOLTAGE_DIVIDER_SCALE 11
/* Plausible LiPo voltage bounds (mV) for sanity-checking scaling. */
#define BATTERY_VOLTAGE_MIN_MV 2000
#define BATTERY_VOLTAGE_MAX_MV 5000

/* Plausibility window for the raw ADC-pin millivolt reading itself
 * (i.e. BEFORE applying VOLTAGE_DIVIDER_SCALE).
 *
 * - The nRF52 SAADC pin physically can only see 0..0.6 V (ADC_GAIN_1) or
 *   0..3.6 V (ADC_GAIN_1_6). Anything outside [50 mV, 4000 mV] at the pin
 *   means the sample is corrupt — typically:
 *     * raw=-1 sign-issue from a uint vs int16_t mistake
 *     * the divider FET hasn't actually powered up (raw≈0)
 *     * pin contention with PPG/ACC bring-up
 *
 * Bogus samples are dropped without updating battery_value or the smoothing
 * history, and never fall into the critical-low shutdown path.
 */
#define IMPLAUSIBLE_RAW_MV_MIN  50
#define IMPLAUSIBLE_RAW_MV_MAX  4000

/* CG-320B user gauge (FW >= 1.0.68): 4.35V = 100%, 3.61V = remapped 0%.
 * Chemistry still discharges toward ~3.0 V; 3.61 V is operational empty so
 * BLE/wireless recovery stay reliable. True protect remains CRITICAL_LOW.
 */
#define CG320B_VMAX_MV 4350
#define CG320B_VMIN_MV  3610

/* Chemistry empty for diagnostic % only (not the user gauge). */
#define CG320B_CHEMISTRY_VMIN_MV 3000

/* Critical low threshold - protects cell from over-discharge */
#define CRITICAL_LOW_VOLTAGE_MV 2800

/* Rolling max of recent readings to ignore LED-pulse voltage sag.
 * Prevents "percent jumps" during high-current PPG LED pulses.
 */
#define VOLTAGE_SMOOTH_SAMPLES 3
static int32_t voltage_history[VOLTAGE_SMOOTH_SAMPLES];
static uint8_t voltage_history_idx;

static const struct adc_dt_spec adc_chan0 = ADC_DT_SPEC_GET_BY_IDX(DT_PATH(zephyr_user), 0);
static const struct gpio_dt_spec battery_enable = GPIO_DT_SPEC_GET_BY_IDX(DT_PATH(zephyr_user), baten_gpios, 0);

/* Boost-regulator latch (BATEN / P0.10) early-init.
 *
 * On battery power, P0.10 is the enable latch for the on-board boost
 * regulator that produces the chip's 3V3 rail. The regulator's enable
 * input has an external pull-down: any time P0.10 is left as a Zephyr
 * input or floating, it is pulled LOW, the boost de-latches, the rail
 * decays through the output cap, and the chip browns out.
 *
 * Previously this pin was first asserted inside battery_init(), which is
 * called from safe_boot_work_handler() at t = CONFIG_ORALABLE_SAFE_BOOT_DELAY_S
 * (10 s). The 10-second window between every CPU reset and that first
 * GPIO drive was long enough for the boost to drop, leaving the device
 * dead and SWD unresponsive ("Could not connect to target") even though
 * the J-Link saw VTref = 3.3 V from the dev-board side. v1.0.22..v1.0.24
 * all hit this trap after any soft reset (MPU fault, watchdog, JLink r).
 *
 * Fix: drive BATEN HIGH from a SYS_INIT() that runs immediately after
 * the GPIO driver is ready, before main() and any user threads. That
 * collapses the float window from 10 s to a few hundred microseconds
 * (just MCUBoot + Zephyr arch init), which is well within the boost
 * regulator's hold time.
 */
static int oralable_baten_early_assert(void)
{
    if (!gpio_is_ready_dt(&battery_enable)) {
        return -ENODEV;
    }
    return gpio_pin_configure_dt(&battery_enable, GPIO_OUTPUT_HIGH);
}
SYS_INIT(oralable_baten_early_assert, POST_KERNEL,
         CONFIG_KERNEL_INIT_PRIORITY_DEFAULT);

/* MUST be int16_t. The nRF52 SAADC stores 12-bit samples as a SIGNED 16-bit
 * value. With single-ended input and the divider unpowered/transient, the
 * SAADC happily returns a small negative reading (e.g. raw=-1 = 0xFFFF) which,
 * if cast through uint16_t, becomes 65535 and scales to ~57.6 V at the pin —
 * the v1.0.17 "raw_mv=57596" symptom. Storing as int16_t makes the sign
 * extend correctly so a -1 raw becomes ~0 mV after adc_raw_to_millivolts_dt,
 * which our IMPLAUSIBLE_RAW_MV guard then rejects.
 */
static int16_t adc_buf;
static struct adc_sequence sequence = {
    .buffer = &adc_buf,
    .buffer_size = sizeof(adc_buf),
};

static int32_t battery_value;

static struct k_work_delayable battery_measurement_work;

static battery_data_ready_t app_data_ready;

static uint16_t measurement_interval_s = CONFIG_BATTERY_MEASUREMENT_INTERVAL;

static bool is_plausible_battery_mv(int32_t mv)
{
    return (mv >= BATTERY_VOLTAGE_MIN_MV && mv <= BATTERY_VOLTAGE_MAX_MV);
}

static int32_t battery_adc_sample_mv(void)
{
    int err;

    /* P0.10 (baten) is the boost-regulator latch on REV10 — keep it HIGH. */
    err = adc_read(adc_chan0.dev, &sequence);
    if (err)
    {
        LOG_ERR("ADC read failed, err %d", err);
        return 0;
    }

    int32_t raw_mv = (int32_t)adc_buf;

    err = adc_raw_to_millivolts_dt(&adc_chan0, &raw_mv);
    if (err)
    {
        LOG_ERR("ADC raw to millivolts failed, err %d", err);
        return 0;
    }
    if (raw_mv < IMPLAUSIBLE_RAW_MV_MIN || raw_mv > IMPLAUSIBLE_RAW_MV_MAX)
    {
        LOG_WRN("Battery: implausible raw_mv=%d (window %d..%dmV) — sample discarded",
                raw_mv, IMPLAUSIBLE_RAW_MV_MIN, IMPLAUSIBLE_RAW_MV_MAX);
        return 0;
    }

    const int32_t v_div = raw_mv * VOLTAGE_DIVIDER_SCALE;
    const int32_t v_nodiv = raw_mv;
    const int32_t v_div_over6 = (raw_mv * VOLTAGE_DIVIDER_SCALE) / 6;
    const int32_t v_nodiv_over6 = raw_mv / 6;
    int32_t chosen = v_div;

    if (!is_plausible_battery_mv(chosen)) {
        if (is_plausible_battery_mv(v_div_over6)) {
            chosen = v_div_over6;
            LOG_WRN("Battery scaling fallback: using divider/6 (raw_mv=%d -> %dmV)", raw_mv, chosen);
        } else if (is_plausible_battery_mv(v_nodiv)) {
            chosen = v_nodiv;
            LOG_WRN("Battery scaling fallback: using no-divider (raw_mv=%d -> %dmV)", raw_mv, chosen);
        } else if (is_plausible_battery_mv(v_nodiv_over6)) {
            chosen = v_nodiv_over6;
            LOG_WRN("Battery scaling fallback: using no-divider/6 (raw_mv=%d -> %dmV)", raw_mv, chosen);
        } else {
            LOG_WRN("Battery scaling out of range: raw_mv=%d v_div=%d — sample discarded",
                    raw_mv, v_div);
            return 0;
        }
    }
    return chosen;
}

int32_t battery_read_now_mv(void)
{
    return battery_adc_sample_mv();
}

static void take_battery_measurement(struct k_work *work)
{
    ARG_UNUSED(work);

    const int32_t chosen = battery_adc_sample_mv();

    if (chosen > 0) {
        battery_value = chosen;

        /* Rolling max: ignore brief drops during LED pulses */
        voltage_history[voltage_history_idx] = battery_value;
        voltage_history_idx = (voltage_history_idx + 1) % VOLTAGE_SMOOTH_SAMPLES;
        int32_t max_v = voltage_history[0];
        for (int i = 1; i < VOLTAGE_SMOOTH_SAMPLES; i++) {
            if (voltage_history[i] > max_v) max_v = voltage_history[i];
        }
        uint8_t battery_pct = battery_voltage_to_percent(max_v);

#if defined(CONFIG_BATTERY_CRITICAL_LOW_SHUTDOWN)
        bool history_filled = true;
        for (int i = 0; i < VOLTAGE_SMOOTH_SAMPLES; i++) {
            if (voltage_history[i] == 0) {
                history_filled = false;
                break;
            }
        }
        if (history_filled && max_v < CRITICAL_LOW_VOLTAGE_MV) {
            LOG_ERR("Battery critical: max(last %d)=%dmV < %dmV - shutting down to protect cell",
                    VOLTAGE_SMOOTH_SAMPLES, max_v, CRITICAL_LOW_VOLTAGE_MV);
            k_msleep(100);
            sys_reboot(SYS_REBOOT_COLD);
        }
#endif
        LOG_INF("Battery: %dmV -> gauge=%u%% chem=%u%%",
                battery_value, battery_pct,
                battery_voltage_to_chemistry_percent(battery_value));
        tgm_service_send_battery_notify(battery_value);
        if (app_data_ready)
        {
            app_data_ready(battery_value);
        }
    }

    if (measurement_interval_s > 0)
    {
        k_work_reschedule(&battery_measurement_work, K_SECONDS(measurement_interval_s));
    }
}

int battery_init(battery_data_ready_t battery_data_ready_cb)
{
    if (!adc_is_ready_dt(&adc_chan0))
    {
        LOG_ERR("ADC device not ready");
        return -ENODEV;
    }

    int err = adc_channel_setup_dt(&adc_chan0);
    if (err)
    {
        LOG_ERR("ADC channel setup failed, err %d", err);
        return err;
    }

    err = adc_sequence_init_dt(&adc_chan0, &sequence);
    if (err)
    {
        LOG_ERR("ADC sequence init failed, err %d", err);
        return err;
    }

    app_data_ready = battery_data_ready_cb;
    k_work_init_delayable(&battery_measurement_work, take_battery_measurement);

    /* Initialize voltage history for smoothing */
    for (int i = 0; i < VOLTAGE_SMOOTH_SAMPLES; i++) {
        voltage_history[i] = 0;
    }
    voltage_history_idx = 0;

    /* Drive baten (P0.10) HIGH for the lifetime of the device — boost latch. */
    err = gpio_pin_configure_dt(&battery_enable, GPIO_OUTPUT_HIGH);
    if (err)
    {
        LOG_ERR("GPIO pin configure (baten=HIGH) failed, err %d", err);
        return err;
    }

    k_sleep(K_MSEC(20));

    return 0;
}

int battery_start_measurement()
{
    // Take an immediate measurement
    int err = k_work_reschedule(&battery_measurement_work, K_NO_WAIT);
    if (err < 0)
    {
        return err;
    }
    else
    {
        return 0;
    }
}

int32_t battery_get_last_measurement()
{
    return battery_value;
}

uint8_t battery_voltage_to_percent(int32_t voltage_mv)
{
    /* User gauge: 4.35V = 100%, 3.61V = remapped 0% (operational empty). */
    if (voltage_mv >= CG320B_VMAX_MV) return 100;
    if (voltage_mv <= CG320B_VMIN_MV) return 0;
    /* percent = (V - Vmin) * 100 / (Vmax - Vmin) */
    int32_t range = CG320B_VMAX_MV - CG320B_VMIN_MV;
    int32_t pct = (voltage_mv - CG320B_VMIN_MV) * 100 / range;
    return (uint8_t)(pct > 100 ? 100 : pct);
}

uint8_t battery_voltage_to_chemistry_percent(int32_t voltage_mv)
{
    /* Full chemistry span: 4.35V = 100%, 3.0V = 0%. */
    if (voltage_mv >= CG320B_VMAX_MV) {
        return 100;
    }
    if (voltage_mv <= CG320B_CHEMISTRY_VMIN_MV) {
        return 0;
    }
    int32_t range = CG320B_VMAX_MV - CG320B_CHEMISTRY_VMIN_MV;
    int32_t pct = (voltage_mv - CG320B_CHEMISTRY_VMIN_MV) * 100 / range;
    return (uint8_t)(pct > 100 ? 100 : pct);
}

uint8_t battery_get_percentage(void)
{
    return battery_voltage_to_percent(battery_value);
}

bool battery_below_soft_floor(void)
{
    if (battery_value <= 0) {
        return false;
    }

    const uint8_t pct = battery_voltage_to_percent(battery_value);

    return (pct < 5) || (battery_value < CG320B_VMIN_MV);
}

void battery_get_usage_telemetry(struct battery_usage_telemetry_t *out)
{
    if (!out) {
        return;
    }
    out->voltage_mv = battery_value;
    out->percent = battery_voltage_to_percent(battery_value);
    /* app/ target currently has no power_profiler module wired in. */
    out->mah_consumed_scaled = 0;
    out->remaining_minutes = 0;
}

void battery_set_measurement_interval_seconds(uint16_t seconds)
{
    measurement_interval_s = seconds;
    /* Defensive: do NOT reschedule if the work has not yet been initialised
     * (battery_init() not yet called from safe_boot_work_handler). Scheduling
     * an uninitialised k_work_delayable corrupts the kernel timeout list when
     * k_work_init_delayable() later zeroes the struct. handler==NULL is the
     * canonical "not init'd" sentinel for k_work.
     */
    if (measurement_interval_s > 0 && battery_measurement_work.work.handler != NULL)
    {
        k_work_reschedule(&battery_measurement_work, K_SECONDS(measurement_interval_s));
    }
}

uint16_t battery_get_measurement_interval_seconds(void)
{
    return measurement_interval_s;
}
```

## src/battery.h
```c
/*
 * Copyright (c) 2024 WeeGee bv
 */

#ifndef BATTERY_H_
#define BATTERY_H_

#include <zephyr/kernel.h>

typedef void (*battery_data_ready_t)(int32_t battery_value);

struct battery_usage_telemetry_t {
	uint32_t voltage_mv;
	uint8_t percent;
	uint32_t mah_consumed_scaled;
	uint32_t remaining_minutes;
};

int battery_init(battery_data_ready_t battery_data_ready_cb);
int battery_start_measurement(void);
int32_t battery_get_last_measurement(void);
/** One ADC sample now, unsmoothed. 0 if the read is implausible. Does not update the gauge. */
int32_t battery_read_now_mv(void);
/** User / remapped gauge (3.61 V = 0%, 4.35 V = 100%). */
uint8_t battery_voltage_to_percent(int32_t voltage_mv);
/** Chemistry curve (3.0 V = 0%, 4.35 V = 100%) — for logs / diagnostics only. */
uint8_t battery_voltage_to_chemistry_percent(int32_t voltage_mv);
void battery_get_usage_telemetry(struct battery_usage_telemetry_t *out);
void battery_set_measurement_interval_seconds(uint16_t seconds);
/** True when last gauge is <5% or <3.61 V. False if no sample yet (mv<=0). */
bool battery_below_soft_floor(void);

#endif /* BATTERY_H_ */
```

## src/battery_led_indicator.c
```c
/*
 * Copyright (c) 2024 WeeGee bv
 *
 * Off-body battery status using PPG LEDs (Phase 0 vitals policy):
 *
 * Status LEDs are green-only. Never drive red for charge / idle status.
 *
 * On dock / charger (no BLE) — LTC4124 STAT:
 *   - Flashing green while charge_active (STAT blinking) and SOC/voltage still low
 *   - Solid green when charge_active is false (taper / hold)
 *   - Solid green when SOC or voltage is already high even if STAT still blinks
 *     (avoids days of flash-green on a cell that is already hold-range)
 *
 * Off dock (no BLE): status LEDs off.
 *
 * BLE connected:
 *   - No status LEDs — optical emitters are PPG-only (red/IR while PPG CCC is on).
 */

#include "battery_led_indicator.h"
#include "ppg.h"

#include <zephyr/kernel.h>
#include <zephyr/logging/log.h>

LOG_MODULE_REGISTER(battery_led, CONFIG_APP_LOG_LEVEL);

/** Status LED peak PA (~half prior drive; iOS mirrors state when dim). */
#define LED_PA_STATUS 28U
/** Asymmetric flash: brief pulse, long off — on-dock only. */
#define LED_FLASH_ON_MS 350U
#define LED_FLASH_ON_DOCK_MS 2000U

enum indicator_pattern {
	INDICATOR_NONE = 0,
	INDICATOR_SOLID_GREEN,
	INDICATOR_FLASH_GREEN,
};

static struct k_work_delayable flash_work;
static enum indicator_pattern active_pattern = INDICATOR_NONE;
static bool flash_phase_on;
static uint32_t led_gen;
static uint32_t flash_gen;

static bool should_hold_solid_green(uint8_t battery_pct, int32_t battery_mv)
{
	if (battery_pct >= BATTERY_LED_HOLD_GREEN_PCT) {
		return true;
	}
	return battery_mv >= BATTERY_LED_HOLD_GREEN_MV;
}

static void stop_flash(void)
{
	(void)k_work_cancel_delayable(&flash_work);
	active_pattern = INDICATOR_NONE;
}

static void apply_dark(void)
{
	stop_flash();
	(void)ppg_ensure_awake();
	(void)ppg_set_led_pa(PPG_LED_GREEN, 0U);
	(void)ppg_set_led_pa(PPG_LED_RED, 0U);
	(void)ppg_set_led_pa(PPG_LED_IR, 0U);
	(void)ppg_stop_streaming();
}

static void flash_work_handler(struct k_work *work)
{
	ARG_UNUSED(work);

	if (flash_gen != led_gen) {
		return;
	}

	(void)ppg_ensure_awake_status_leds();

	if (flash_gen != led_gen) {
		return;
	}

	flash_phase_on = !flash_phase_on;
	(void)ppg_set_led_pa(PPG_LED_RED, 0U);
	(void)ppg_set_led_pa(PPG_LED_IR, 0U);
	(void)ppg_set_led_pa(PPG_LED_GREEN, flash_phase_on ? LED_PA_STATUS : 0U);
	const uint32_t delay_ms = flash_phase_on ? LED_FLASH_ON_MS
						 : LED_FLASH_ON_DOCK_MS;
	(void)k_work_reschedule(&flash_work, K_MSEC(delay_ms));
}

static void start_flash_green(void)
{
	flash_gen = led_gen;

	if (active_pattern == INDICATOR_FLASH_GREEN) {
		(void)ppg_set_led_pa(PPG_LED_RED, 0U);
		(void)ppg_set_led_pa(PPG_LED_IR, 0U);
		(void)ppg_set_led_pa(PPG_LED_GREEN,
				     flash_phase_on ? LED_PA_STATUS : 0U);
		const uint32_t delay_ms = flash_phase_on ? LED_FLASH_ON_MS
							 : LED_FLASH_ON_DOCK_MS;
		(void)k_work_reschedule(&flash_work, K_MSEC(delay_ms));
		return;
	}

	stop_flash();
	active_pattern = INDICATOR_FLASH_GREEN;
	flash_phase_on = true;
	flash_gen = led_gen;
	(void)ppg_set_led_pa(PPG_LED_RED, 0U);
	(void)ppg_set_led_pa(PPG_LED_IR, 0U);
	(void)ppg_set_led_pa(PPG_LED_GREEN, LED_PA_STATUS);
	(void)k_work_reschedule(&flash_work, K_MSEC(LED_FLASH_ON_MS));
}

static void apply_solid_green(void)
{
	if (active_pattern == INDICATOR_SOLID_GREEN) {
		(void)ppg_set_led_pa(PPG_LED_RED, 0U);
		(void)ppg_set_led_pa(PPG_LED_IR, 0U);
		(void)ppg_set_led_pa(PPG_LED_GREEN, LED_PA_STATUS);
		return;
	}

	stop_flash();
	active_pattern = INDICATOR_SOLID_GREEN;
	(void)ppg_set_led_pa(PPG_LED_RED, 0U);
	(void)ppg_set_led_pa(PPG_LED_IR, 0U);
	(void)ppg_set_led_pa(PPG_LED_GREEN, LED_PA_STATUS);
}

int battery_led_indicator_init(void)
{
	k_work_init_delayable(&flash_work, flash_work_handler);
	return 0;
}

void battery_led_indicator_suspend(void)
{
	led_gen++;
	apply_dark();
}

void battery_led_indicator_apply(bool on_dock, bool worn, uint8_t battery_pct,
				 int32_t battery_mv, bool charge_active)
{
	led_gen++;

	if (worn) {
		stop_flash();
		LOG_INF("Battery LED: on_dock=%d charge=%d worn=%d mv=%dmV pct=%u -> pattern %d",
			on_dock, charge_active, worn, battery_mv, battery_pct, active_pattern);
		return;
	}

	if (!on_dock) {
		apply_dark();
		LOG_INF("Battery LED: on_dock=%d charge=%d worn=%d mv=%dmV pct=%u -> pattern %d",
			on_dock, charge_active, worn, battery_mv, battery_pct, active_pattern);
		return;
	}

	(void)ppg_ensure_awake_status_leds();
	(void)ppg_set_led_pa(PPG_LED_RED, 0U);
	(void)ppg_set_led_pa(PPG_LED_IR, 0U);

	if (!charge_active || should_hold_solid_green(battery_pct, battery_mv)) {
		apply_solid_green();
	} else {
		start_flash_green();
	}

	LOG_INF("Battery LED: on_dock=%d charge=%d worn=%d mv=%dmV pct=%u -> pattern %d",
		on_dock, charge_active, worn, battery_mv, battery_pct, active_pattern);
}
```

## src/battery_led_indicator.h
```c
/*
 * Copyright (c) 2024 WeeGee bv
 *
 * Off-body battery status via PPG LEDs. Status indication is green-only.
 * Never drive red for charge / idle (PPG red/IR is sensing only, while worn).
 */

#ifndef BATTERY_LED_INDICATOR_H_
#define BATTERY_LED_INDICATOR_H_

#include <stdbool.h>
#include <stdint.h>

/** Battery % above which a full-looking SOC is clamped on-pad (legacy). */
#define BATTERY_LED_FULL_THRESHOLD_PCT 80
/** On-pad: solid green at/above this SOC even if STAT still blinks. */
#define BATTERY_LED_HOLD_GREEN_PCT 70
/** On-pad: solid green at/above this voltage even if STAT still blinks. */
#define BATTERY_LED_HOLD_GREEN_MV 4050

int battery_led_indicator_init(void);

/**
 * Apply battery/charge indicator LEDs when the device is NOT worn.
 * No-op when @p worn is true (PPG sensing owns red/IR).
 *
 * Status LEDs never use red.
 *
 * On dock (no BLE):
 *   - Flash green only while charging with SOC/voltage still below hold
 *   - Solid green on STAT taper / hold, or when SOC/voltage is already high
 * Off dock: status LEDs off.
 * Caller must not invoke this while BLE is connected (status LEDs off).
 */
void battery_led_indicator_apply(bool on_dock, bool worn, uint8_t battery_pct,
				 int32_t battery_mv, bool charge_active);

/** Stop battery-indicator flash work and turn off status LEDs (connect probe). */
void battery_led_indicator_suspend(void);

#endif /* BATTERY_LED_INDICATOR_H_ */
```

## src/ble.c
```c
/*
 * Copyright (c) 2024 WeeGee bv
 */

#include <stdbool.h>
#include <zephyr/bluetooth/addr.h>
#include <zephyr/bluetooth/conn.h>
#include <zephyr/bluetooth/gap.h>
#include <zephyr/bluetooth/gatt.h>
#include <zephyr/bluetooth/hci.h>
#include <zephyr/bluetooth/uuid.h>

#include "ble.h"
#include "tgm_service.h"

#include <zephyr/kernel.h>
#include <zephyr/logging/log.h>
LOG_MODULE_REGISTER(ble, CONFIG_APP_LOG_LEVEL);

/* TGM primary service — scan response helps nRF Connect / iOS identify Oralable without relying on name alone. */
#define ORALABLE_TGM_SVC_UUID_VAL \
    BT_UUID_128_ENCODE(0x3a0ff000, 0x98c4, 0x46b2, 0x94af, 0x1aee0fd4c48e)

static const struct bt_data ad[] = {
    BT_DATA_BYTES(BT_DATA_FLAGS, (BT_LE_AD_GENERAL | BT_LE_AD_NO_BREDR)),
    BT_DATA(BT_DATA_NAME_COMPLETE, DEVICE_NAME, DEVICE_NAME_LEN),
};

static const struct bt_data sd[] = {
    BT_DATA_BYTES(BT_DATA_UUID128_ALL, ORALABLE_TGM_SVC_UUID_VAL),
};

static struct k_work adv_work;
static struct k_work_delayable adv_fallback_work;
static struct bt_conn *current_conn;
static bool connected;
static bool advertising;
/** Fast connectable advertising until this uptime (ms), then slow interval to save energy. */
static int64_t fast_adv_until_ms;

#define ADV_FALLBACK_S 2

static const char *hci_disconnect_reason_str(uint8_t reason)
{
    switch (reason)
    {
    case BT_HCI_ERR_CONN_TIMEOUT:
        return "connection/supervision timeout";
    case BT_HCI_ERR_REMOTE_USER_TERM_CONN:
        return "remote user terminated";
    case BT_HCI_ERR_LOCALHOST_TERM_CONN:
        return "local host terminated";
    case 0x3d:
        return "MIC failure";
    case 0x3e:
        return "failed to establish";
    default:
        return "see Core Spec Vol 2 Part D";
    }
}

bool ble_is_connected(void)
{
    return connected;
}

bool ble_is_advertising(void)
{
    return advertising;
}

static void adv_fallback_work_handler(struct k_work *work)
{
    ARG_UNUSED(work);

    if (connected)
    {
        return;
    }

    LOG_WRN("Adv fallback: .recycled missed — starting advertising");
    tgm_service_fw_log_printf("fw: adv fallback recycled-miss");
    k_work_submit(&adv_work);
}

void ble_ensure_advertising(void)
{
    if (connected)
    {
        /* Zombie: stack still "connected", CCC on, no notifies — red stays
         * on and advertising never restarts.
         */
        if (tgm_service_sensor_stream_stale() ||
            tgm_service_link_notify_idle())
        {
            ble_force_recover("connected idle/stale stream");
        }
        return;
    }

    /* Nordic samples restart advertising only when it is not running.
     * Do not force-stop healthy advertising (avoids masking stack issues).
     */
    if (!advertising)
    {
        k_work_submit(&adv_work);
    }
}

void ble_force_recover(const char *why)
{
    LOG_WRN("BLE recover: %s connected=%d", why ? why : "?", connected);
    tgm_service_fw_log_printf("fw: ble recover %s", why ? why : "?");
    tgm_service_clear_optical_leds();

    if (current_conn)
    {
        (void)bt_conn_disconnect(current_conn, BT_HCI_ERR_REMOTE_USER_TERM_CONN);
    }

    if (connected)
    {
        connected = false;
        advertising = false;
        tgm_service_on_disconnect();
    }

    fast_adv_until_ms = k_uptime_get() + 90000;
    (void)k_work_reschedule(&adv_fallback_work, K_SECONDS(ADV_FALLBACK_S));
}

void mtu_exchange_cb(
    struct bt_conn *conn, uint8_t att_err,
    struct bt_gatt_exchange_params *params)
{
    if (att_err)
    {
        LOG_ERR("MTU exchange returned with error code %d", att_err);
    }
    else
    {
        LOG_INF("MTU sucessfully set to %d", CONFIG_BT_L2CAP_TX_MTU);
    }
}

static void request_mtu_exchange(struct bt_conn *conn)
{
    int err;
    static struct bt_gatt_exchange_params exchange_params;
    exchange_params.func = mtu_exchange_cb;

    err = bt_gatt_exchange_mtu(conn, &exchange_params);
    if (err)
    {
        LOG_ERR("MTU exchange failed (err %d)", err);
    }
    else
    {
        LOG_INF("MTU exchange pending ...");
    }
}

static void request_conn_param_update(struct bt_conn *conn)
{
    struct bt_le_conn_param preferred = BT_LE_CONN_PARAM_INIT(
        CONFIG_BT_PERIPHERAL_PREF_MIN_INT,
        CONFIG_BT_PERIPHERAL_PREF_MAX_INT,
        CONFIG_BT_PERIPHERAL_PREF_LATENCY,
        CONFIG_BT_PERIPHERAL_PREF_TIMEOUT);

    int err = bt_conn_le_param_update(conn, &preferred);
    if (err)
    {
        LOG_WRN("Connection parameter update request failed: %d", err);
    }
    else
    {
        LOG_INF("Connection parameter update requested (timeout %d ms)",
                CONFIG_BT_PERIPHERAL_PREF_TIMEOUT * 10);
    }
}

static void request_data_len_update(struct bt_conn *conn)
{
    int err;

    err = bt_conn_le_data_len_update(conn, BT_LE_DATA_LEN_PARAM_MAX);
    if (err)
    {
        LOG_ERR("Data length update request failed: %d", err);
        return;
    }

    LOG_INF("Data length updated to %d", CONFIG_BT_CTLR_DATA_LENGTH_MAX);
    request_mtu_exchange(conn);
}

void on_connected(struct bt_conn *conn, uint8_t err)
{
    if (err)
    {
        LOG_ERR("Connection error %d", err);
        return;
    }

    char addr[BT_ADDR_LE_STR_LEN];
    bt_addr_le_to_str(bt_conn_get_dst(conn), addr, sizeof(addr));
    LOG_INF("Connected to device with address %s", addr);

    struct bt_conn_info info;
    err = bt_conn_get_info(conn, &info);
    if (err)
    {
        LOG_ERR("bt_conn_get_info() returned %d", err);
        return;
    }

    double connection_interval = info.le.interval * 1.25; // in ms
    uint16_t supervision_timeout = info.le.timeout * 10;  // in ms
    LOG_INF("Connection parameters: interval %.2f ms, latency %d intervals, timeout %d ms",
            connection_interval, info.le.latency, supervision_timeout);

    if (current_conn)
    {
        bt_conn_unref(current_conn);
        current_conn = NULL;
    }
    current_conn = bt_conn_ref(conn);
    connected = true;
    advertising = false;
    (void)k_work_cancel_delayable(&adv_fallback_work);
    tgm_service_on_connected();

    /* Prefer long supervision timeout before CCC storm (iOS often starts ~240–720 ms). */
    request_conn_param_update(conn);
    request_data_len_update(conn);
}

void on_disconnected(struct bt_conn *conn, uint8_t reason)
{
    ARG_UNUSED(conn);

    LOG_INF("Disconnected, HCI reason 0x%02x (%s)", reason, hci_disconnect_reason_str(reason));

    if (current_conn)
    {
        bt_conn_unref(current_conn);
        current_conn = NULL;
    }

    if (connected)
    {
        connected = false;
        advertising = false;
        tgm_service_on_disconnect();
    }

    fast_adv_until_ms = k_uptime_get() + 90000;
    /* Prefer .recycled; if it never runs, fallback starts adv. */
    (void)k_work_reschedule(&adv_fallback_work, K_SECONDS(ADV_FALLBACK_S));
}

/**
 * Connection object fully released — safe point to restart advertising
 * (Nordic Academy BLE Fundamentals Lesson 2 / extended_adv sample).
 */
static void on_recycled(void)
{
    LOG_INF("Connection recycled; restarting advertising");
    (void)k_work_cancel_delayable(&adv_fallback_work);
    k_work_submit(&adv_work);
}

void on_le_param_updated(struct bt_conn *conn, uint16_t interval, uint16_t latency, uint16_t timeout)
{
    ARG_UNUSED(conn);

    double connection_interval = interval * 1.25; // in ms
    uint16_t supervision_timeout = timeout * 10;  // in ms
    LOG_INF("Connection parameters updated: interval %.2f ms, latency %d intervals, timeout %d ms",
            connection_interval, latency, supervision_timeout);
}

struct bt_conn_cb connection_callbacks = {
    .connected = on_connected,
    .disconnected = on_disconnected,
    .le_param_updated = on_le_param_updated,
    .recycled = on_recycled,
};

static void advertising_process(struct k_work *work)
{
    int err;

    ARG_UNUSED(work);

    if (connected)
    {
        return;
    }

    if (advertising)
    {
        (void)bt_le_adv_stop();
        advertising = false;
    }

    struct bt_le_adv_param adv_param = *BT_LE_ADV_PARAM(
        (BT_LE_ADV_OPT_CONNECTABLE | BT_LE_ADV_OPT_USE_IDENTITY),
        (k_uptime_get() < fast_adv_until_ms) ? 160 : 800,
        (k_uptime_get() < fast_adv_until_ms) ? 161 : 801,
        NULL);

    LOG_INF("Starting connectable advertising (interval ~%s)",
            (k_uptime_get() < fast_adv_until_ms) ? "100 ms" : "500 ms");
    err = bt_le_adv_start(&adv_param, ad, ARRAY_SIZE(ad), sd, ARRAY_SIZE(sd));
    if (err && err != -EALREADY)
    {
        LOG_ERR("Advertising failed to start, err: %d", err);
        return;
    }

    advertising = true;
    LOG_INF("Advertising started");
}

/**
 * @brief Initialize the BLE functionality
 *
 * Register the callbacks and enable the BLE stack
 *
 * @return int Error code
 */
int ble_init(void)
{
    // Register connection callbacks
    bt_conn_cb_register(&connection_callbacks);

    k_work_init(&adv_work, advertising_process);
    k_work_init_delayable(&adv_fallback_work, adv_fallback_work_handler);

    int err = bt_enable(NULL);
    if (err)
    {
        LOG_ERR("Bluetooth init failed (err %d)\n", err);
        return err;
    }
    LOG_INF("Bluetooth initialized\n");

    return 0;
}

/**
 * @brief Start advertising
 *
 * Start advertising with preset parameters
 *
 * @return int Error code
 */
int ble_adv_start(void)
{
    k_work_submit(&adv_work);
    return 0;
}
```

## src/ble.h
```c
/*
 * Copyright (c) 2024 WeeGee bv
 */

#ifndef BLE_H_
#define BLE_H_

#include <stdbool.h>

/**@file
 * @defgroup ble BLE Service
 * @{
 * @brief API for interacting with the BLE functionality
 */

#define DEVICE_NAME CONFIG_BT_DEVICE_NAME
#define DEVICE_NAME_LEN (sizeof(DEVICE_NAME) - 1)

int ble_init(void);
int ble_adv_start(void);

/** @return true when connectable advertising is active. */
bool ble_is_advertising(void);

/** Restart advertising if not connected and not already advertising. */
void ble_ensure_advertising(void);

/** @return true when a central is connected. */
bool ble_is_connected(void);

/** Drop a stuck link, stop sensors/LEDs, and restart advertising if recycle is late. */
void ble_force_recover(const char *why);

/**
 * @}
 */

#endif /* BLE_H_ */
```

## src/charge_detector.c
```c
/*
 * Copyright (c) 2024 WeeGee bv
 */

#include "charge_detector.h"

#include <zephyr/logging/log.h>

LOG_MODULE_REGISTER(charge_det, CONFIG_APP_LOG_LEVEL);

/** CG-320B at Vmax — above this, cell is full (trickle only). */
#define CHARGE_FULL_MV 4320

/** Minimum rise across history window to declare active charge. */
#define CHARGE_MIN_RISE_MV 12

#define CHARGE_HISTORY_LEN 4

static int32_t voltage_history[CHARGE_HISTORY_LEN];
static uint8_t voltage_history_count;
static bool charge_active;
static bool last_gpio_on_dock;

static void append_voltage(int32_t battery_mv)
{
	if (voltage_history_count < CHARGE_HISTORY_LEN)
	{
		voltage_history[voltage_history_count++] = battery_mv;
	}
	else
	{
		for (int i = 1; i < CHARGE_HISTORY_LEN; i++)
		{
			voltage_history[i - 1] = voltage_history[i];
		}

		voltage_history[CHARGE_HISTORY_LEN - 1] = battery_mv;
	}
}

void charge_detector_reset(void)
{
	voltage_history_count = 0;
	charge_active = false;
	last_gpio_on_dock = false;
}

bool charge_detector_infers_on_dock(void)
{
	return false;
}

bool charge_detector_update(int32_t battery_mv, bool gpio_on_dock)
{
	if (gpio_on_dock && !last_gpio_on_dock)
	{
		voltage_history_count = 0;
		charge_active = true;
	}

	last_gpio_on_dock = gpio_on_dock;
	append_voltage(battery_mv);

	if (!gpio_on_dock)
	{
		charge_active = false;
		return false;
	}

	if (battery_mv >= CHARGE_FULL_MV)
	{
		charge_active = false;
		LOG_DBG("Charge inactive: at Vmax (%dmV)", battery_mv);
		return false;
	}

	if (voltage_history_count < 2)
	{
		return charge_active;
	}

	const int32_t oldest = voltage_history[0];
	const int32_t rise_mv = battery_mv - oldest;

	if (rise_mv >= CHARGE_MIN_RISE_MV)
	{
		charge_active = true;
	}
	else if (rise_mv <= -CHARGE_MIN_RISE_MV)
	{
		charge_active = false;
	}

	LOG_DBG("Charge detect: mv=%d rise=%dmV gpio=%d active=%d",
		battery_mv, rise_mv, gpio_on_dock, charge_active);

	return charge_active;
}

bool charge_detector_is_active(void)
{
	return charge_active;
}
```
