## app/drivers/sensor/Kconfig
```kconfig
# Copyright (c) 2021 Nordic Semiconductor ASA
# SPDX-License-Identifier: Apache-2.0

rsource "maxm86161/Kconfig"
rsource "lis2dtw12/Kconfig"
```

## app/drivers/sensor/maxm86161/Kconfig
```kconfig
# Copyright (c) 2024 WeeGee bv

config MAXM86161
	bool "Driver for MAXM86161"
	default n
	select GPIO
	help
	  Enable driver for MAXM86161 sensor.


if MAXM86161

module = MAXM86161
module-str = maxm86161
source "subsys/logging/Kconfig.template.log_config"

endif # MAXM86161
```

## boards/byteexplain/pcb00003/Kconfig
```kconfig
# PCB00003 nRF52832 board configuration

# Copyright (c) 2018 Nordic Semiconductor ASA
# SPDX-License-Identifier: Apache-2.0

if BOARD_PCB00003

config BOARD_ENABLE_DCDC
	bool "DCDC mode"
	select SOC_DCDC_NRF52X
	default y

# BT_CTLR depends on BT. When BT is enabled we should default to also
# enabling the controller.
config BT_CTLR
	default y if BT

endif # BOARD_PCB00003
```

## boards/byteexplain/pcb00003/Kconfig.pcb00003
```kconfig
# a200451 board configuration

# Copyright (c) 2018 Nordic Semiconductor ASA
# SPDX-License-Identifier: Apache-2.0

config BOARD_PCB00003
	select SOC_NRF52832_QFAA
```

## boards/byteexplain/pcb00003/board.yml
```yaml
board:
  name: pcb00003
  vendor: byteexplain
  revision:
    format: number
    default: "6"
    revisions:
      - name: "6"
  socs:
    - name: nrf52832
```

## drivers/sensor/lis2dtw12/Kconfig
```kconfig
# Copyright (c) 2024 WeeGee bv

config LIS2DTW12
	bool "Driver for LIS2DTW12"
	default n
	select GPIO
	help
	  Enable driver for LIS2DTW12 sensor.


if LIS2DTW12

module = LIS2DTW12
module-str = LIS2DTW12
source "subsys/logging/Kconfig.template.log_config"

endif # LIS2DTW12
```

## dts/bindings/sensor/st,lis2dtw12.yaml
```yaml
# Copyright (c) 2024 WeeGee bv

description: LIS2DTW12 MEMS digital output dual motion and temperature sensor

compatible: "st,lis2dtw12"

include: [sensor-device.yaml, i2c-device.yaml]

properties:
  int-gpios:
    type: phandle-array
    required: false
    description: Interrupt pin.
```
